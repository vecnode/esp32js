## hw/tpm/Kconfig
```kconfig
config TPM_TIS_I2C
    bool
    depends on TPM
    select TPM_BACKEND
    select I2C
    select TPM_TIS

config TPM_TIS_ISA
    bool
    depends on TPM && ISA_BUS
    select TPM_TIS

config TPM_TIS_SYSBUS
    bool
    depends on TPM
    select TPM_TIS

config TPM_TIS
    bool
    depends on TPM
    select TPM_BACKEND
```

## hw/vfio/Kconfig
```kconfig
config VFIO
    bool
    depends on LINUX

config VFIO_PCI
    bool
    default y
    select VFIO
    select EDID
    depends on LINUX && PCI

config VFIO_PLATFORM
    bool
    default y
    select VFIO
    depends on LINUX && PLATFORM_BUS

config VFIO_XGMAC
    bool
    default y
    depends on VFIO_PLATFORM

config VFIO_AMD_XGBE
    bool
    default y
    depends on VFIO_PLATFORM

config VFIO_IGD
    bool
    depends on VFIO_PCI
```
